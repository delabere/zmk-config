## config/west.yml
```yaml
manifest:
  remotes:
    - name: zmkfirmware
      url-base: https://github.com/zmkfirmware
  projects:
    - name: zmk
      remote: zmkfirmware
      revision: 64daf698e073e37b6748ac54f4eb48d8666af0b9  # main
      import: app/west.yml
  self:
    path: config
```
